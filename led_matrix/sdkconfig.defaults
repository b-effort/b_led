## led_matrix/sdkconfig.defaults
```kconfig
# required
CONFIG_FREERTOS_HZ=1000
CONFIG_ESP_TLS_PSK_VERIFICATION=y

# flash
CONFIG_ESPTOOLPY_FLASHMODE_QIO=y

# compiler
CONFIG_COMPILER_OPTIMIZATION_PERF=y

# esp32s3
CONFIG_ESP32S3_REV_MIN_2=y
CONFIG_ESP32S3_DEFAULT_CPU_FREQ_240=y

# rtos
INCLUDE_uxTaskGetStackHighWaterMark=1
INCLUDE_uxTaskGetStackHighWaterMark2=1

# wifi
# https://github.com/espressif/esp-idf/blob/master/examples/wifi/iperf/sdkconfig.defaults.esp32s3
CONFIG_ESP32_WIFI_STATIC_RX_BUFFER_NUM=16
CONFIG_ESP32_WIFI_DYNAMIC_RX_BUFFER_NUM=64
CONFIG_ESP32_WIFI_RX_BA_WIN=32
CONFIG_LWIP_IRAM_OPTIMIZATION=y
CONFIG_LWIP_EXTRA_IRAM_OPTIMIZATION=y
CONFIG_LWIP_TCPIP_TASK_AFFINITY_CPU0=y
CONFIG_LWIP_TCP_WND_DEFAULT=65535
CONFIG_LWIP_TCP_RECVMBOX_SIZE=48
CONFIG_LWIP_TCPIP_RECVMBOX_SIZE=48
```
